// SPDX-License-Identifier: GPL-2.0
/* Copyright (c) 2022, The Linux Foundation. All rights reserved.
 *
 * This program is free software; you can redistribute it and/or modify
 * it under the terms of the GNU General Public License version 2 and
 * only version 2 as published by the Free Software Foundation.
 *
 * This program is distributed in the hope that it will be useful,
 * but WITHOUT ANY WARRANTY; without even the implied warranty of
 * MERCHANTABILITY or FITNESS FOR A PARTICULAR PURPOSE.  See the
 * GNU General Public License for more details.
 */

#include "dsi-panel-m82-36-02-0a-video.dtsi"
#include "dsi-panel-m82-42-02-0b-video.dtsi"

&sde_dsi {
	/delete-property/ vdd-supply;
	/delete-property/ avdd-supply;
	qcom,dsi-default-panel = <&dsi_k81_42_02_0a_dual_cphy_video>;
};

&dsi_k81_42_02_0a_dual_cphy_video {
	qcom,panel-supply-entries = <&dsi_panel_k11_pwr_supply_vci>;
	qcom,dsi-select-clocks = "mux_byte_clk0", "mux_pixel_clk0";
    qcom,platform-te-gpio = <&tlmm 66 0>;
    qcom,platform-reset-gpio = <&tlmm 12 0>;
};
