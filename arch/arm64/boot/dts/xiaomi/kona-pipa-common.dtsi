// SPDX-License-Identifier: GPL-2.0
/* Copyright (c) 2022, The Linux Foundation. All rights reserved.
 *
 * This program is free software; you can redistribute it and/or modify
 * it under the terms of the GNU General Public License version 2 and
 * only version 2 as published by the Free Software Foundation.
 *
 * This program is distributed in the hope that it will be useful,
 * but WITHOUT ANY WARRANTY; without even the implied warranty of
 * MERCHANTABILITY or FITNESS FOR A PARTICULAR PURPOSE.  See the
 * GNU General Public License for more details.
 */

#include "kona-gourami-common.dtsi"
#include "kona-pipa-audio.dtsi"
#include "kona-pipa-battery.dtsi"
#include "kona-pipa-camera-sensor.dtsi"
#include "kona-pipa-display.dtsi"
#include "kona-pipa-pcie.dtsi"
#include "kona-pipa-pinctrl.dtsi"
#include "kona-pipa-regulators.dtsi"
#include "kona-pipa-thermal.dtsi"
#include "kona-pipa-touch.dtsi"
#include "kona-pipa-usb.dtsi"
